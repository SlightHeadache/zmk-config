## config/boards/shields/choctopus44/Kconfig.defconfig
```kconfig
# Copyright (c) 2021 The ZMK Contributors
# SPDX-License-Identifier: MIT

if SHIELD_CHOCTOPUS44

config ZMK_KEYBOARD_NAME
    default "Choctopus44v2"

endif
```

## config/boards/shields/choctopus44/Kconfig.shield
```kconfig
# Copyright (c) 2021 The ZMK Contributors
# SPDX-License-Identifier: MIT

config SHIELD_CHOCTOPUS44
    def_bool $(shields_list_contains,choctopus44)
```
